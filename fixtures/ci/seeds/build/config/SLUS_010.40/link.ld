SECTIONS
{
    __romPos = 0;
    _gp = 0x80033674;
    header_ROM_START = __romPos;
    header_VRAM = ADDR(.header);
    .header : AT(header_ROM_START) SUBALIGN(4)
    {
        FILL(0x00000000);
        header_DATA_START = .;
        build/src/SLUS_010.40/header.o(.data);
        header_DATA_END = .;
        header_DATA_SIZE = ABSOLUTE(header_DATA_END - header_DATA_START);
    }
    __romPos += SIZEOF(.header);
    header_ROM_END = __romPos;
    header_VRAM_END = .;

    _800_ROM_START = __romPos;
    _800_VRAM = ADDR(._800);
    ._800 0x80010000 : AT(_800_ROM_START) SUBALIGN(4)
    {
        FILL(0x00000000);
        _800_RODATA_START = .;
        build/src/SLUS_010.40/overlay.o(.rodata);
        build/src/SLUS_010.40/25AC.o(.rodata);
        build/src/SLUS_010.40/libspu/SPU.o(.rodata);
        build/src/SLUS_010.40/libspu/S_SI.o(.rodata);
        build/src/SLUS_010.40/libetc/VSYNC.o(.rodata);
        build/src/SLUS_010.40/libetc/INTR.o(.rodata);
        build/src/SLUS_010.40/libetc/INTR_DMA.o(.rodata);
        build/src/SLUS_010.40/libcd/SYS.o(.rodata);
        build/src/SLUS_010.40/libcd/BIOS.o(.rodata);
        build/src/SLUS_010.40/libcd/C_011.o(.rodata);
        build/src/SLUS_010.40/libds/DSSYS_2.o(.rodata);
        build/src/SLUS_010.40/libds/DSSYS_1.o(.rodata);
        build/src/SLUS_010.40/libc/SPRINTF.o(.rodata);
        build/src/SLUS_010.40/libgpu/FONT.o(.rodata);
        build/src/SLUS_010.40/libgpu/SYS.o(.rodata);
        build/src/SLUS_010.40/libpad/PADENTRY.o(.rodata);
        build/src/SLUS_010.40/libgte/MTX_003.o(.rodata);
        build/src/SLUS_010.40/libgte/MSC00.o(.rodata);
        build/src/SLUS_010.40/libgte/PATCHGTE.o(.rodata);
        build/src/SLUS_010.40/libspu/S_INI.o(.rodata);
        build/src/SLUS_010.40/libspu/S_DCB.o(.rodata);
        build/src/SLUS_010.40/libsnd/UT_ROFF.o(.rodata);
        build/src/SLUS_010.40/libsnd/UT_RON.o(.rodata);
        build/src/SLUS_010.40/libspu/S_Q.o(.rodata);
        build/src/SLUS_010.40/libspu/S_M_INIT.o(.rodata);
        build/src/SLUS_010.40/libspu/S_SNC.o(.rodata);
        build/src/SLUS_010.40/libspu/S_SR.o(.rodata);
        build/src/SLUS_010.40/libspu/S_M_UTIL.o(.rodata);
        build/src/SLUS_010.40/libspu/S_SIA.o(.rodata);
        build/src/SLUS_010.40/libspu/S_SIC.o(.rodata);
        build/src/SLUS_010.40/libspu/S_CB.o(.rodata);
        build/src/SLUS_010.40/libspu/S_R.o(.rodata);
        build/src/SLUS_010.40/libspu/S_W.o(.rodata);
        build/src/SLUS_010.40/libspu/S_STSA.o(.rodata);
        build/src/SLUS_010.40/libspu/S_STM.o(.rodata);
        build/src/SLUS_010.40/libspu/S_STC.o(.rodata);
        build/src/SLUS_010.40/libspu/S_GVEA.o(.rodata);
        build/src/SLUS_010.40/libspu/S_SCMV.o(.rodata);
        build/src/SLUS_010.40/libspu/S_SRMT.o(.rodata);
        build/src/SLUS_010.40/libspu/S_SRA.o(.rodata);
        build/src/SLUS_010.40/libspu/S_CRWA.o(.rodata);
        build/src/SLUS_010.40/libspu/S_SRMD.o(.rodata);
        build/src/SLUS_010.40/libspu/S_GRMT.o(.rodata);
        build/src/SLUS_010.40/libsn/SNMAIN.o(.rodata);
        build/src/SLUS_010.40/libetc/INTR_VB.o(.rodata);
        build/src/SLUS_010.40/libetc/VMODE.o(.rodata);
        build/src/SLUS_010.40/libcd/CDROM.o(.rodata);
        build/src/SLUS_010.40/libcd/C_002.o(.rodata);
        build/src/SLUS_010.40/libcd/C_003.o(.rodata);
        build/src/SLUS_010.40/libcd/C_004.o(.rodata);
        build/src/SLUS_010.40/libcd/C_005.o(.rodata);
        build/src/SLUS_010.40/libcd/C_007.o(.rodata);
        build/src/SLUS_010.40/libcd/C_008.o(.rodata);
        build/src/SLUS_010.40/libcd/C_009.o(.rodata);
        build/src/SLUS_010.40/libcd/C_010.o(.rodata);
        build/src/SLUS_010.40/libds/DSSYS_3.o(.rodata);
        build/src/SLUS_010.40/libds/DSSYS_4.o(.rodata);
        build/src/SLUS_010.40/libds/DSREAD.o(.rodata);
        build/src/SLUS_010.40/libds/DSREAD2.o(.rodata);
        build/src/SLUS_010.40/libds/DSREADY.o(.rodata);
        build/src/SLUS_010.40/libds/DSCB.o(.rodata);
        build/src/SLUS_010.40/libapi/C57.o(.rodata);
        build/src/SLUS_010.40/libapi/C68.o(.rodata);
        build/src/SLUS_010.40/libapi/C112.o(.rodata);
        build/src/SLUS_010.40/libapi/C114.o(.rodata);
        build/src/SLUS_010.40/libapi/C161.o(.rodata);
        build/src/SLUS_010.40/libapi/A07.o(.rodata);
        build/src/SLUS_010.40/libapi/A08.o(.rodata);
        build/src/SLUS_010.40/libapi/A09.o(.rodata);
        build/src/SLUS_010.40/libapi/A10.o(.rodata);
        build/src/SLUS_010.40/libapi/A11.o(.rodata);
        build/src/SLUS_010.40/libapi/A12.o(.rodata);
        build/src/SLUS_010.40/libapi/A13.o(.rodata);
        build/src/SLUS_010.40/libapi/A23.o(.rodata);
        build/src/SLUS_010.40/libapi/A24.o(.rodata);
        build/src/SLUS_010.40/libapi/A25.o(.rodata);
        build/src/SLUS_010.40/libapi/A32.o(.rodata);
        build/src/SLUS_010.40/libapi/A36.o(.rodata);
        build/src/SLUS_010.40/libapi/A37.o(.rodata);
        build/src/SLUS_010.40/libapi/A50.o(.rodata);
        build/src/SLUS_010.40/libapi/A52.o(.rodata);
        build/src/SLUS_010.40/libapi/A53.o(.rodata);
        build/src/SLUS_010.40/libapi/A54.o(.rodata);
        build/src/SLUS_010.40/libapi/A67.o(.rodata);
        build/src/SLUS_010.40/libapi/A68.o(.rodata);
        build/src/SLUS_010.40/libapi/A69.o(.rodata);
        build/src/SLUS_010.40/libapi/A91.o(.rodata);
        build/src/SLUS_010.40/libapi/L10.o(.rodata);
        build/src/SLUS_010.40/libapi/COUNTER.o(.rodata);
        build/src/SLUS_010.40/libapi/FIRST.o(.rodata);
        build/src/SLUS_010.40/libapi/A66.o(.rodata);
        build/src/SLUS_010.40/libc/A63.o(.rodata);
        build/src/SLUS_010.40/libc/C19.o(.rodata);
        build/src/SLUS_010.40/libc/C23.o(.rodata);
        build/src/SLUS_010.40/libc/C25.o(.rodata);
        build/src/SLUS_010.40/libc/C27.o(.rodata);
        build/src/SLUS_010.40/libc/C42.o(.rodata);
        build/src/SLUS_010.40/libc/C43.o(.rodata);
        build/src/SLUS_010.40/libc/C47.o(.rodata);
        build/src/SLUS_010.40/libc/C48.o(.rodata);
        build/src/SLUS_010.40/libc/C63.o(.rodata);
        build/src/SLUS_010.40/libc/C46.o(.rodata);
        build/src/SLUS_010.40/libc/MEMMOVE.o(.rodata);
        build/src/SLUS_010.40/libc/MEMCMP.o(.rodata);
        build/src/SLUS_010.40/libgpu/C73.o(.rodata);
        build/src/SLUS_010.40/libgpu/E00.o(.rodata);
        build/src/SLUS_010.40/libgpu/E02.o(.rodata);
        build/src/SLUS_010.40/libgpu/E03.o(.rodata);
        build/src/SLUS_010.40/libgpu/E04.o(.rodata);
        build/src/SLUS_010.40/libgpu/P00.o(.rodata);
        build/src/SLUS_010.40/libgpu/P01.o(.rodata);
        build/src/SLUS_010.40/libgpu/P06.o(.rodata);
        build/src/SLUS_010.40/libgpu/P07.o(.rodata);
        build/src/SLUS_010.40/libgpu/P09.o(.rodata);
        build/src/SLUS_010.40/libgpu/P10.o(.rodata);
        build/src/SLUS_010.40/libgpu/P16.o(.rodata);
        build/src/SLUS_010.40/libgpu/P17.o(.rodata);
        build/src/SLUS_010.40/libgpu/P18.o(.rodata);
        build/src/SLUS_010.40/libgpu/P20.o(.rodata);
        build/src/SLUS_010.40/libgpu/P22.o(.rodata);
        build/src/SLUS_010.40/libgpu/P26.o(.rodata);
        build/src/SLUS_010.40/libgpu/P27.o(.rodata);
        build/src/SLUS_010.40/libgpu/P33.o(.rodata);
        build/src/SLUS_010.40/libgpu/P34.o(.rodata);
        build/src/SLUS_010.40/libgpu/P41.o(.rodata);
        build/src/SLUS_010.40/libpad/PADMAIN.o(.rodata);
        build/src/SLUS_010.40/libapi/L02.o(.rodata);
        build/src/SLUS_010.40/libapi/L03.o(.rodata);
        build/src/SLUS_010.40/libpad/PADCMD.o(.rodata);
        build/src/SLUS_010.40/libpad/PADIF.o(.rodata);
        build/src/SLUS_010.40/libpad/PADPORTD.o(.rodata);
        build/src/SLUS_010.40/libc/C40.o(.rodata);
        build/src/SLUS_010.40/libpad/PADSEQD.o(.rodata);
        build/src/SLUS_010.40/libpad/WAITRC2.o(.rodata);
        build/src/SLUS_010.40/libcard/C171.o(.rodata);
        build/src/SLUS_010.40/libcard/C172.o(.rodata);
        build/src/SLUS_010.40/libcard/CARD.o(.rodata);
        build/src/SLUS_010.40/libcard/A78.o(.rodata);
        build/src/SLUS_010.40/libcard/A80.o(.rodata);
        build/src/SLUS_010.40/libcard/INIT.o(.rodata);
        build/src/SLUS_010.40/libapi/PAD.o(.rodata);
        build/src/SLUS_010.40/libapi/A18.o(.rodata);
        build/src/SLUS_010.40/libapi/A19.o(.rodata);
        build/src/SLUS_010.40/libapi/A20.o(.rodata);
        build/src/SLUS_010.40/libapi/A21.o(.rodata);
        build/src/SLUS_010.40/libapi/PATCH.o(.rodata);
        build/src/SLUS_010.40/libapi/CHCLRPAD.o(.rodata);
        build/src/SLUS_010.40/libcard/A74.o(.rodata);
        build/src/SLUS_010.40/libcard/A75.o(.rodata);
        build/src/SLUS_010.40/libcard/A76.o(.rodata);
        build/src/SLUS_010.40/libcard/PATCH.o(.rodata);
        build/src/SLUS_010.40/libcard/END.o(.rodata);
        build/src/SLUS_010.40/libcard/FORMAT.o(.rodata);
        build/src/SLUS_010.40/libcard/A79.o(.rodata);
        build/src/SLUS_010.40/libcard/A92.o(.rodata);
        . = ALIGN(., 4);
        _800_RODATA_END = .;
        _800_RODATA_SIZE = ABSOLUTE(_800_RODATA_END - _800_RODATA_START);
        _800_TEXT_START = .;
        build/src/SLUS_010.40/overlay.o(.text);
        build/src/SLUS_010.40/libgte/MTX_003.o(.text);
        build/src/SLUS_010.40/libgte/MSC00.o(.text);
        build/src/SLUS_010.40/libgte/PATCHGTE.o(.text);
        build/src/SLUS_010.40/25AC.o(.text);
        build/src/SLUS_010.40/libspu/S_INI.o(.text);
        build/src/SLUS_010.40/libspu/SPU.o(.text);
        build/src/SLUS_010.40/libspu/S_DCB.o(.text);
        build/src/SLUS_010.40/libsnd/UT_ROFF.o(.text);
        build/src/SLUS_010.40/libsnd/UT_RON.o(.text);
        build/src/SLUS_010.40/libspu/S_Q.o(.text);
        build/src/SLUS_010.40/libspu/S_M_INIT.o(.text);
        build/src/SLUS_010.40/libspu/S_SNC.o(.text);
        build/src/SLUS_010.40/libspu/S_SR.o(.text);
        build/src/SLUS_010.40/libspu/S_M_UTIL.o(.text);
        build/src/SLUS_010.40/libspu/S_SI.o(.text);
        build/src/SLUS_010.40/libspu/S_SIA.o(.text);
        build/src/SLUS_010.40/libspu/S_SIC.o(.text);
        build/src/SLUS_010.40/libspu/S_CB.o(.text);
        build/src/SLUS_010.40/libspu/S_R.o(.text);
        build/src/SLUS_010.40/libspu/S_W.o(.text);
        build/src/SLUS_010.40/libspu/S_STSA.o(.text);
        build/src/SLUS_010.40/libspu/S_STM.o(.text);
        build/src/SLUS_010.40/libspu/S_STC.o(.text);
        build/src/SLUS_010.40/libspu/S_GVEA.o(.text);
        build/src/SLUS_010.40/libspu/S_SCMV.o(.text);
        build/src/SLUS_010.40/libspu/S_SRMT.o(.text);
        build/src/SLUS_010.40/libspu/S_SRA.o(.text);
        build/src/SLUS_010.40/libspu/S_CRWA.o(.text);
        build/src/SLUS_010.40/libspu/S_SRMD.o(.text);
        build/src/SLUS_010.40/libspu/S_GRMT.o(.text);
        build/src/SLUS_010.40/libsn/SNMAIN.o(.text);
        build/src/SLUS_010.40/libetc/VSYNC.o(.text);
        build/src/SLUS_010.40/libetc/INTR.o(.text);
        build/src/SLUS_010.40/libetc/INTR_VB.o(.text);
        build/src/SLUS_010.40/libetc/INTR_DMA.o(.text);
        build/src/SLUS_010.40/libetc/VMODE.o(.text);
        build/src/SLUS_010.40/libcd/CDROM.o(.text);
        build/src/SLUS_010.40/libcd/SYS.o(.text);
        build/src/SLUS_010.40/libcd/BIOS.o(.text);
        build/src/SLUS_010.40/libcd/C_002.o(.text);
        build/src/SLUS_010.40/libcd/C_003.o(.text);
        build/src/SLUS_010.40/libcd/C_004.o(.text);
        build/src/SLUS_010.40/libcd/C_005.o(.text);
        build/src/SLUS_010.40/libcd/C_007.o(.text);
        build/src/SLUS_010.40/libcd/C_008.o(.text);
        build/src/SLUS_010.40/libcd/C_009.o(.text);
        build/src/SLUS_010.40/libcd/C_010.o(.text);
        build/src/SLUS_010.40/libcd/C_011.o(.text);
        build/src/SLUS_010.40/libds/DSSYS_2.o(.text);
        build/src/SLUS_010.40/libds/DSSYS_1.o(.text);
        build/src/SLUS_010.40/libds/DSSYS_3.o(.text);
        build/src/SLUS_010.40/libds/DSSYS_4.o(.text);
        build/src/SLUS_010.40/libds/DSREAD.o(.text);
        build/src/SLUS_010.40/libds/DSREAD2.o(.text);
        build/src/SLUS_010.40/libds/DSREADY.o(.text);
        build/src/SLUS_010.40/libds/DSCB.o(.text);
        build/src/SLUS_010.40/libapi/C57.o(.text);
        build/src/SLUS_010.40/libapi/C68.o(.text);
        build/src/SLUS_010.40/libapi/C112.o(.text);
        build/src/SLUS_010.40/libapi/C114.o(.text);
        build/src/SLUS_010.40/libapi/C161.o(.text);
        build/src/SLUS_010.40/libapi/A07.o(.text);
        build/src/SLUS_010.40/libapi/A08.o(.text);
        build/src/SLUS_010.40/libapi/A09.o(.text);
        build/src/SLUS_010.40/libapi/A10.o(.text);
        build/src/SLUS_010.40/libapi/A11.o(.text);
        build/src/SLUS_010.40/libapi/A12.o(.text);
        build/src/SLUS_010.40/libapi/A13.o(.text);
        build/src/SLUS_010.40/libapi/A23.o(.text);
        build/src/SLUS_010.40/libapi/A24.o(.text);
        build/src/SLUS_010.40/libapi/A25.o(.text);
        build/src/SLUS_010.40/libapi/A32.o(.text);
        build/src/SLUS_010.40/libapi/A36.o(.text);
        build/src/SLUS_010.40/libapi/A37.o(.text);
        build/src/SLUS_010.40/libapi/A50.o(.text);
        build/src/SLUS_010.40/libapi/A52.o(.text);
        build/src/SLUS_010.40/libapi/A53.o(.text);
        build/src/SLUS_010.40/libapi/A54.o(.text);
        build/src/SLUS_010.40/libapi/A67.o(.text);
        build/src/SLUS_010.40/libapi/A68.o(.text);
        build/src/SLUS_010.40/libapi/A69.o(.text);
        build/src/SLUS_010.40/libapi/A91.o(.text);
        build/src/SLUS_010.40/libapi/L10.o(.text);
        build/src/SLUS_010.40/libapi/COUNTER.o(.text);
        build/src/SLUS_010.40/libapi/FIRST.o(.text);
        build/src/SLUS_010.40/libapi/A66.o(.text);
        build/src/SLUS_010.40/libc/A63.o(.text);
        build/src/SLUS_010.40/libc/C19.o(.text);
        build/src/SLUS_010.40/libc/C23.o(.text);
        build/src/SLUS_010.40/libc/C25.o(.text);
        build/src/SLUS_010.40/libc/C27.o(.text);
        build/src/SLUS_010.40/libc/C42.o(.text);
        build/src/SLUS_010.40/libc/C43.o(.text);
        build/src/SLUS_010.40/libc/C47.o(.text);
        build/src/SLUS_010.40/libc/C48.o(.text);
        build/src/SLUS_010.40/libc/C63.o(.text);
        build/src/SLUS_010.40/libc/SPRINTF.o(.text);
        build/src/SLUS_010.40/libc/C46.o(.text);
        build/src/SLUS_010.40/libc/MEMMOVE.o(.text);
        build/src/SLUS_010.40/libc/MEMCMP.o(.text);
        build/src/SLUS_010.40/libgpu/FONT.o(.text);
        build/src/SLUS_010.40/libgpu/SYS.o(.text);
        build/src/SLUS_010.40/libgpu/C73.o(.text);
        build/src/SLUS_010.40/libgpu/E00.o(.text);
        build/src/SLUS_010.40/libgpu/E02.o(.text);
        build/src/SLUS_010.40/libgpu/E03.o(.text);
        build/src/SLUS_010.40/libgpu/E04.o(.text);
        build/src/SLUS_010.40/libgpu/P00.o(.text);
        build/src/SLUS_010.40/libgpu/P01.o(.text);
        build/src/SLUS_010.40/libgpu/P06.o(.text);
        build/src/SLUS_010.40/libgpu/P07.o(.text);
        build/src/SLUS_010.40/libgpu/P09.o(.text);
        build/src/SLUS_010.40/libgpu/P10.o(.text);
        build/src/SLUS_010.40/libgpu/P16.o(.text);
        build/src/SLUS_010.40/libgpu/P17.o(.text);
        build/src/SLUS_010.40/libgpu/P18.o(.text);
        build/src/SLUS_010.40/libgpu/P20.o(.text);
        build/src/SLUS_010.40/libgpu/P22.o(.text);
        build/src/SLUS_010.40/libgpu/P26.o(.text);
        build/src/SLUS_010.40/libgpu/P27.o(.text);
        build/src/SLUS_010.40/libgpu/P33.o(.text);
        build/src/SLUS_010.40/libgpu/P34.o(.text);
        build/src/SLUS_010.40/libgpu/P41.o(.text);
        build/src/SLUS_010.40/libpad/PADENTRY.o(.text);
        build/src/SLUS_010.40/libpad/PADMAIN.o(.text);
        build/src/SLUS_010.40/libapi/L02.o(.text);
        build/src/SLUS_010.40/libapi/L03.o(.text);
        build/src/SLUS_010.40/libpad/PADCMD.o(.text);
        build/src/SLUS_010.40/libpad/PADIF.o(.text);
        build/src/SLUS_010.40/libpad/PADPORTD.o(.text);
        build/src/SLUS_010.40/libc/C40.o(.text);
        build/src/SLUS_010.40/libpad/PADSEQD.o(.text);
        build/src/SLUS_010.40/libpad/WAITRC2.o(.text);
        build/src/SLUS_010.40/libcard/C171.o(.text);
        build/src/SLUS_010.40/libcard/C172.o(.text);
        build/src/SLUS_010.40/libcard/CARD.o(.text);
        build/src/SLUS_010.40/libcard/A78.o(.text);
        build/src/SLUS_010.40/libcard/A80.o(.text);
        build/src/SLUS_010.40/libcard/INIT.o(.text);
        build/src/SLUS_010.40/libapi/PAD.o(.text);
        build/src/SLUS_010.40/libapi/A18.o(.text);
        build/src/SLUS_010.40/libapi/A19.o(.text);
        build/src/SLUS_010.40/libapi/A20.o(.text);
        build/src/SLUS_010.40/libapi/A21.o(.text);
        build/src/SLUS_010.40/libapi/PATCH.o(.text);
        build/src/SLUS_010.40/libapi/CHCLRPAD.o(.text);
        build/src/SLUS_010.40/libcard/A74.o(.text);
        build/src/SLUS_010.40/libcard/A75.o(.text);
        build/src/SLUS_010.40/libcard/A76.o(.text);
        build/src/SLUS_010.40/libcard/PATCH.o(.text);
        build/src/SLUS_010.40/libcard/END.o(.text);
        build/src/SLUS_010.40/libcard/FORMAT.o(.text);
        build/src/SLUS_010.40/libcard/A79.o(.text);
        build/src/SLUS_010.40/libcard/A92.o(.text);
        . = ALIGN(., 4);
        _800_TEXT_END = .;
        _800_TEXT_SIZE = ABSOLUTE(_800_TEXT_END - _800_TEXT_START);
        _800_DATA_START = .;
        build/src/SLUS_010.40/overlay.o(.data);
        build/src/SLUS_010.40/25AC.o(.data);
        build/src/SLUS_010.40/libspu/SPU.o(.data);
        build/src/SLUS_010.40/libspu/S_SI.o(.data);
        build/src/SLUS_010.40/libetc/VSYNC.o(.data);
        build/src/SLUS_010.40/libetc/INTR.o(.data);
        build/src/SLUS_010.40/libetc/INTR_DMA.o(.data);
        build/src/SLUS_010.40/libcd/SYS.o(.data);
        build/src/SLUS_010.40/libcd/BIOS.o(.data);
        build/src/SLUS_010.40/libcd/C_011.o(.data);
        build/src/SLUS_010.40/libds/DSSYS_2.o(.data);
        build/src/SLUS_010.40/libds/DSSYS_1.o(.data);
        build/src/SLUS_010.40/libc/SPRINTF.o(.data);
        build/src/SLUS_010.40/libgpu/FONT.o(.data);
        build/src/SLUS_010.40/libgpu/SYS.o(.data);
        build/src/SLUS_010.40/libpad/PADENTRY.o(.data);
        build/src/SLUS_010.40/libgte/MTX_003.o(.data);
        build/src/SLUS_010.40/libgte/MSC00.o(.data);
        build/src/SLUS_010.40/libgte/PATCHGTE.o(.data);
        build/src/SLUS_010.40/libspu/S_INI.o(.data);
        build/src/SLUS_010.40/libspu/S_DCB.o(.data);
        build/src/SLUS_010.40/libsnd/UT_ROFF.o(.data);
        build/src/SLUS_010.40/libsnd/UT_RON.o(.data);
        build/src/SLUS_010.40/libspu/S_Q.o(.data);
        build/src/SLUS_010.40/libspu/S_M_INIT.o(.data);
        build/src/SLUS_010.40/libspu/S_SNC.o(.data);
        build/src/SLUS_010.40/libspu/S_SR.o(.data);
        build/src/SLUS_010.40/libspu/S_M_UTIL.o(.data);
        build/src/SLUS_010.40/libspu/S_SIA.o(.data);
        build/src/SLUS_010.40/libspu/S_SIC.o(.data);
        build/src/SLUS_010.40/libspu/S_CB.o(.data);
        build/src/SLUS_010.40/libspu/S_R.o(.data);
        build/src/SLUS_010.40/libspu/S_W.o(.data);
        build/src/SLUS_010.40/libspu/S_STSA.o(.data);
        build/src/SLUS_010.40/libspu/S_STM.o(.data);
        build/src/SLUS_010.40/libspu/S_STC.o(.data);
        build/src/SLUS_010.40/libspu/S_GVEA.o(.data);
        build/src/SLUS_010.40/libspu/S_SCMV.o(.data);
        build/src/SLUS_010.40/libspu/S_SRMT.o(.data);
        build/src/SLUS_010.40/libspu/S_SRA.o(.data);
        build/src/SLUS_010.40/libspu/S_CRWA.o(.data);
        build/src/SLUS_010.40/libspu/S_SRMD.o(.data);
        build/src/SLUS_010.40/libspu/S_GRMT.o(.data);
        build/src/SLUS_010.40/1FD44.data.o(.data);
        build/src/SLUS_010.40/libsn/SNMAIN.o(.data);
        build/src/SLUS_010.40/libetc/INTR_VB.o(.data);
        build/src/SLUS_010.40/libetc/VMODE.o(.data);
        build/src/SLUS_010.40/libcd/CDROM.o(.data);
        build/src/SLUS_010.40/libcd/C_002.o(.data);
        build/src/SLUS_010.40/libcd/C_003.o(.data);
        build/src/SLUS_010.40/libcd/C_004.o(.data);
        build/src/SLUS_010.40/libcd/C_005.o(.data);
        build/src/SLUS_010.40/libcd/C_007.o(.data);
        build/src/SLUS_010.40/libcd/C_008.o(.data);
        build/src/SLUS_010.40/libcd/C_009.o(.data);
        build/src/SLUS_010.40/libcd/C_010.o(.data);
        build/src/SLUS_010.40/libds/DSSYS_3.o(.data);
        build/src/SLUS_010.40/libds/DSSYS_4.o(.data);
        build/src/SLUS_010.40/libds/DSREAD.o(.data);
        build/src/SLUS_010.40/libds/DSREAD2.o(.data);
        build/src/SLUS_010.40/libds/DSREADY.o(.data);
        build/src/SLUS_010.40/libds/DSCB.o(.data);
        build/src/SLUS_010.40/libapi/C57.o(.data);
        build/src/SLUS_010.40/libapi/C68.o(.data);
        build/src/SLUS_010.40/libapi/C112.o(.data);
        build/src/SLUS_010.40/libapi/C114.o(.data);
        build/src/SLUS_010.40/libapi/C161.o(.data);
        build/src/SLUS_010.40/libapi/A07.o(.data);
        build/src/SLUS_010.40/libapi/A08.o(.data);
        build/src/SLUS_010.40/libapi/A09.o(.data);
        build/src/SLUS_010.40/libapi/A10.o(.data);
        build/src/SLUS_010.40/libapi/A11.o(.data);
        build/src/SLUS_010.40/libapi/A12.o(.data);
        build/src/SLUS_010.40/libapi/A13.o(.data);
        build/src/SLUS_010.40/libapi/A23.o(.data);
        build/src/SLUS_010.40/libapi/A24.o(.data);
        build/src/SLUS_010.40/libapi/A25.o(.data);
        build/src/SLUS_010.40/libapi/A32.o(.data);
        build/src/SLUS_010.40/libapi/A36.o(.data);
        build/src/SLUS_010.40/libapi/A37.o(.data);
        build/src/SLUS_010.40/libapi/A50.o(.data);
        build/src/SLUS_010.40/libapi/A52.o(.data);
        build/src/SLUS_010.40/libapi/A53.o(.data);
        build/src/SLUS_010.40/libapi/A54.o(.data);
        build/src/SLUS_010.40/libapi/A67.o(.data);
        build/src/SLUS_010.40/libapi/A68.o(.data);
        build/src/SLUS_010.40/libapi/A69.o(.data);
        build/src/SLUS_010.40/libapi/A91.o(.data);
        build/src/SLUS_010.40/libapi/L10.o(.data);
        build/src/SLUS_010.40/217DC.data.o(.data);
        build/src/SLUS_010.40/libapi/COUNTER.o(.data);
        build/src/SLUS_010.40/libapi/FIRST.o(.data);
        build/src/SLUS_010.40/libapi/A66.o(.data);
        build/src/SLUS_010.40/libc/A63.o(.data);
        build/src/SLUS_010.40/libc/C19.o(.data);
        build/src/SLUS_010.40/libc/C23.o(.data);
        build/src/SLUS_010.40/libc/C25.o(.data);
        build/src/SLUS_010.40/libc/C27.o(.data);
        build/src/SLUS_010.40/libc/C42.o(.data);
        build/src/SLUS_010.40/libc/C43.o(.data);
        build/src/SLUS_010.40/libc/C47.o(.data);
        build/src/SLUS_010.40/libc/C48.o(.data);
        build/src/SLUS_010.40/libc/C63.o(.data);
        build/src/SLUS_010.40/libc/C46.o(.data);
        build/src/SLUS_010.40/libc/MEMMOVE.o(.data);
        build/src/SLUS_010.40/libc/MEMCMP.o(.data);
        build/src/SLUS_010.40/libgpu/C73.o(.data);
        build/src/SLUS_010.40/libgpu/E00.o(.data);
        build/src/SLUS_010.40/libgpu/E02.o(.data);
        build/src/SLUS_010.40/libgpu/E03.o(.data);
        build/src/SLUS_010.40/libgpu/E04.o(.data);
        build/src/SLUS_010.40/libgpu/P00.o(.data);
        build/src/SLUS_010.40/libgpu/P01.o(.data);
        build/src/SLUS_010.40/libgpu/P06.o(.data);
        build/src/SLUS_010.40/libgpu/P07.o(.data);
        build/src/SLUS_010.40/libgpu/P09.o(.data);
        build/src/SLUS_010.40/libgpu/P10.o(.data);
        build/src/SLUS_010.40/libgpu/P16.o(.data);
        build/src/SLUS_010.40/libgpu/P17.o(.data);
        build/src/SLUS_010.40/libgpu/P18.o(.data);
        build/src/SLUS_010.40/libgpu/P20.o(.data);
        build/src/SLUS_010.40/libgpu/P22.o(.data);
        build/src/SLUS_010.40/libgpu/P26.o(.data);
        build/src/SLUS_010.40/libgpu/P27.o(.data);
        build/src/SLUS_010.40/libgpu/P33.o(.data);
        build/src/SLUS_010.40/libgpu/P34.o(.data);
        build/src/SLUS_010.40/libgpu/P41.o(.data);
        build/src/SLUS_010.40/libpad/PADMAIN.o(.data);
        build/src/SLUS_010.40/libapi/L02.o(.data);
        build/src/SLUS_010.40/libapi/L03.o(.data);
        build/src/SLUS_010.40/libpad/PADCMD.o(.data);
        build/src/SLUS_010.40/libpad/PADIF.o(.data);
        build/src/SLUS_010.40/libpad/PADPORTD.o(.data);
        build/src/SLUS_010.40/libc/C40.o(.data);
        build/src/SLUS_010.40/libpad/PADSEQD.o(.data);
        build/src/SLUS_010.40/libpad/WAITRC2.o(.data);
        build/src/SLUS_010.40/libcard/C171.o(.data);
        build/src/SLUS_010.40/libcard/C172.o(.data);
        build/src/SLUS_010.40/libcard/CARD.o(.data);
        build/src/SLUS_010.40/libcard/A78.o(.data);
        build/src/SLUS_010.40/libcard/A80.o(.data);
        build/src/SLUS_010.40/libcard/INIT.o(.data);
        build/src/SLUS_010.40/libapi/PAD.o(.data);
        build/src/SLUS_010.40/libapi/A18.o(.data);
        build/src/SLUS_010.40/libapi/A19.o(.data);
        build/src/SLUS_010.40/libapi/A20.o(.data);
        build/src/SLUS_010.40/libapi/A21.o(.data);
        build/src/SLUS_010.40/libapi/PATCH.o(.data);
        build/src/SLUS_010.40/libapi/CHCLRPAD.o(.data);
        build/src/SLUS_010.40/libcard/A74.o(.data);
        build/src/SLUS_010.40/libcard/A75.o(.data);
        build/src/SLUS_010.40/libcard/A76.o(.data);
        build/src/SLUS_010.40/libcard/PATCH.o(.data);
        build/src/SLUS_010.40/libcard/END.o(.data);
        build/src/SLUS_010.40/libcard/FORMAT.o(.data);
        build/src/SLUS_010.40/libcard/A79.o(.data);
        build/src/SLUS_010.40/libcard/A92.o(.data);
        build/src/SLUS_010.40/23054.data.o(.data);
        . = ALIGN(., 4);
        _800_DATA_END = .;
        _800_DATA_SIZE = ABSOLUTE(_800_DATA_END - _800_DATA_START);
        _800_SBSS_START = .;
        build/src/SLUS_010.40/libsn/SNMAIN.o(.sbss);
        . = ALIGN(., 4);
        _800_SBSS_END = .;
        _800_SBSS_SIZE = ABSOLUTE(_800_SBSS_END - _800_SBSS_START);
        _800_BSS_START = .;
        build/src/SLUS_010.40/libgte/PATCHGTE.o(.bss);
        build/src/SLUS_010.40/23E90.bss.o(.bss);
        build/src/SLUS_010.40/libapi/FIRST.o(.bss);
        build/src/SLUS_010.40/2A6A0.bss.o(.bss);
        build/src/SLUS_010.40/libapi/CHCLRPAD.o(.bss);
        build/src/SLUS_010.40/306D8.bss.o(.bss);
        . = ALIGN(., 4);
        _800_BSS_END = .;
        _800_BSS_SIZE = ABSOLUTE(_800_BSS_END - _800_BSS_START);
    }
    __romPos += SIZEOF(._800);
    __romPos = ALIGN(__romPos, 4);
    . = ALIGN(., 4);
    _800_ROM_END = __romPos;
    _800_VRAM_END = .;

    _30A10_ROM_START = __romPos;
    _30A10_VRAM = ADDR(._30A10);
    ._30A10 0x80040210 : AT(_30A10_ROM_START) SUBALIGN(4)
    {
        FILL(0x00000000);
        _30A10_RODATA_START = .;
        build/src/SLUS_010.40/31724.o(.rodata);
        build/src/SLUS_010.40/32154.rodata.o(.rodata);
        build/src/SLUS_010.40/libgte/MTX_005.o(.rodata);
        build/src/SLUS_010.40/libgte/REG13.o(.rodata);
        build/src/SLUS_010.40/libgte/REG12.o(.rodata);
        build/src/SLUS_010.40/libgte/REG11.o(.rodata);
        build/src/SLUS_010.40/libgte/MTX_12.o(.rodata);
        build/src/SLUS_010.40/libgte/MTX_09.o(.rodata);
        build/src/SLUS_010.40/libgte/MTX_004.o(.rodata);
        build/src/SLUS_010.40/libgte/MTX_06.o(.rodata);
        build/src/SLUS_010.40/libgte/MTX_05.o(.rodata);
        build/src/SLUS_010.40/libgte/SMP_05.o(.rodata);
        build/src/SLUS_010.40/libgte/SMP_04.o(.rodata);
        build/src/SLUS_010.40/libgte/SMP_02.o(.rodata);
        build/src/SLUS_010.40/libgte/CMB_02.o(.rodata);
        build/src/SLUS_010.40/libgte/MTX_07.o(.rodata);
        build/src/SLUS_010.40/libgte/CMB_00.o(.rodata);
        . = ALIGN(., 4);
        _30A10_RODATA_END = .;
        _30A10_RODATA_SIZE = ABSOLUTE(_30A10_RODATA_END - _30A10_RODATA_START);
        _30A10_TEXT_START = .;
        build/src/SLUS_010.40/31724.o(.text);
        build/src/SLUS_010.40/libgte/MTX_005.o(.text);
        build/src/SLUS_010.40/libgte/REG13.o(.text);
        build/src/SLUS_010.40/libgte/REG12.o(.text);
        build/src/SLUS_010.40/libgte/REG11.o(.text);
        build/src/SLUS_010.40/libgte/MTX_12.o(.text);
        build/src/SLUS_010.40/libgte/MTX_09.o(.text);
        build/src/SLUS_010.40/libgte/MTX_004.o(.text);
        build/src/SLUS_010.40/libgte/MTX_06.o(.text);
        build/src/SLUS_010.40/libgte/MTX_05.o(.text);
        build/src/SLUS_010.40/libgte/SMP_05.o(.text);
        build/src/SLUS_010.40/libgte/SMP_04.o(.text);
        build/src/SLUS_010.40/libgte/SMP_02.o(.text);
        build/src/SLUS_010.40/libgte/CMB_02.o(.text);
        build/src/SLUS_010.40/libgte/MTX_07.o(.text);
        build/src/SLUS_010.40/libgte/CMB_00.o(.text);
        build/src/SLUS_010.40/32154.o(.text);
        . = ALIGN(., 4);
        _30A10_TEXT_END = .;
        _30A10_TEXT_SIZE = ABSOLUTE(_30A10_TEXT_END - _30A10_TEXT_START);
        _30A10_DATA_START = .;
        build/src/SLUS_010.40/31724.o(.data);
        build/src/SLUS_010.40/32154.o(.data);
        build/src/SLUS_010.40/libgte/MTX_005.o(.data);
        build/src/SLUS_010.40/libgte/REG13.o(.data);
        build/src/SLUS_010.40/libgte/REG12.o(.data);
        build/src/SLUS_010.40/libgte/REG11.o(.data);
        build/src/SLUS_010.40/libgte/MTX_12.o(.data);
        build/src/SLUS_010.40/libgte/MTX_09.o(.data);
        build/src/SLUS_010.40/libgte/MTX_004.o(.data);
        build/src/SLUS_010.40/libgte/MTX_06.o(.data);
        build/src/SLUS_010.40/libgte/MTX_05.o(.data);
        build/src/SLUS_010.40/libgte/SMP_05.o(.data);
        build/src/SLUS_010.40/libgte/SMP_04.o(.data);
        build/src/SLUS_010.40/libgte/SMP_02.o(.data);
        build/src/SLUS_010.40/libgte/CMB_02.o(.data);
        build/src/SLUS_010.40/libgte/MTX_07.o(.data);
        build/src/SLUS_010.40/libgte/CMB_00.o(.data);
        . = ALIGN(., 4);
        _30A10_DATA_END = .;
        _30A10_DATA_SIZE = ABSOLUTE(_30A10_DATA_END - _30A10_DATA_START);
    }
    __romPos += SIZEOF(._30A10);
    __romPos = ALIGN(__romPos, 4);
    . = ALIGN(., 4);
    _30A10_ROM_END = __romPos;
    _30A10_VRAM_END = .;

    _32568_ROM_START = __romPos;
    _32568_VRAM = ADDR(._32568);
    ._32568 0x80041D68 : AT(_32568_ROM_START) SUBALIGN(4)
    {
        FILL(0x00000000);
        _32568_RODATA_START = .;
        build/src/SLUS_010.40/main.o(.rodata);
        . = ALIGN(., 4);
        _32568_RODATA_END = .;
        _32568_RODATA_SIZE = ABSOLUTE(_32568_RODATA_END - _32568_RODATA_START);
        _32568_TEXT_START = .;
        build/src/SLUS_010.40/main.o(.text);
        . = ALIGN(., 4);
        _32568_TEXT_END = .;
        _32568_TEXT_SIZE = ABSOLUTE(_32568_TEXT_END - _32568_TEXT_START);
        _32568_DATA_START = .;
        build/src/SLUS_010.40/2MBYTE.OBJ.o(.data);
        build/assets/SLUS_010.40/_nowLoading.rgba16Header.img.o(.data);
        build/src/SLUS_010.40/main.o(.data);
        build/src/SLUS_010.40/3C1DC.data.o(.data);
        build/src/SLUS_010.40/zndFiles.o(.data);
        build/src/SLUS_010.40/404CC.data.o(.data);
        . = ALIGN(., 4);
        _32568_DATA_END = .;
        _32568_DATA_SIZE = ABSOLUTE(_32568_DATA_END - _32568_DATA_START);
        _32568_BSS_START = .;
        build/src/SLUS_010.40/main.bss.o(.bss);
        . = ALIGN(., 4);
        _32568_BSS_END = .;
        _32568_BSS_SIZE = ABSOLUTE(_32568_BSS_END - _32568_BSS_START);
    }
    __romPos += SIZEOF(._32568);
    __romPos = ALIGN(__romPos, 4);
    . = ALIGN(., 4);
    _32568_ROM_END = __romPos;
    _32568_VRAM_END = .;

    /DISCARD/ :
    {
        *(*);
    }
}
